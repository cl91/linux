## arch/ntos/Kconfig
```kconfig
config NTOS
	def_bool y
	depends on EXPERT && !SMP && !CPU_BIG_ENDIAN && !SECCOMP && !UPROBES && !COMPAT && !USER_RETURN_NOTIFIER && CC_IS_CLANG
	select CC_NO_ARRAY_BOUNDS
	select ARCH_VMLINUX_NEEDS_RELOCS
	select ARCH_SUPPORTS_LTO_CLANG
	select ARCH_SUPPORTS_LTO_CLANG_THIN
	select LTO_CLANG_THIN
	select ARCH_SUPPORTS_ATOMIC_RMW
	select HAVE_MOD_ARCH_SPECIFIC if TARGET_ARCH_ARM64
	select HAS_IOPORT if TARGET_ARCH_X86
	select GENERIC_HWEIGHT
	select THREAD_INFO_IN_TASK
	select HAVE_PAGE_SIZE_4KB
	select SPARSEMEM
	select SPARSEMEM_MANUAL
	select SPARSEMEM_EXTREME
	select GENERIC_CLOCKEVENTS
	select GENERIC_CPU_DEVICES
	select NO_HZ_IDLE
	select NO_PREEMPT
	select ARCH_WANT_FRAME_POINTERS
	select UACCESS_MEMCPY
	select GENERIC_STRNCPY_FROM_USER
	select GENERIC_STRNLEN_USER
	select HAVE_ARCH_KASAN
	select TINY_RCU
	select TINY_SRCU
	select CONSTRUCTORS
	select HAVE_LD_DEAD_CODE_DATA_ELIMINATION
	select LD_DEAD_CODE_DATA_ELIMINATION
	select MODULES_USE_ELF_REL if !64BIT
	select MODULES_USE_ELF_RELA if 64BIT
	select NET_BASE

config OUTPUT_FORMAT
	string
	default $(shell,echo $OUTPUT_FORMAT)

config ARCH_DMA_ADDR_T_64BIT
	def_bool 64BIT

config ARCH_SELECT_MEMORY_MODEL
	def_bool n

config ARCH_SPARSEMEM_ENABLE
	def_bool y

config SPARSEMEM_VMEMMAP_ENABLE
	def_bool n

config PHYS_ADDR_T_64BIT
	def_bool 64BIT

config 64BIT
	def_bool $(shell,echo $TARGET_ARCH_64BIT)

config TARGET_ARCH_X86
	def_bool $(shell,echo $TARGET_ARCH_X86)

config TARGET_ARCH_ARM64
	def_bool $(shell,echo $TARGET_ARCH_ARM64)

config ARM64_PA_BITS
        int
        default 48

config COREDUMP
	def_bool n

config CPU_BIG_ENDIAN
	def_bool n

config GENERIC_CSUM
	def_bool y

config GENERIC_HWEIGHT
	def_bool y

config NO_IOPORT_MAP
	def_bool y

config SPARSE_IRQ
	def_bool y

config HZ
	int
	default 1000

config CONSOLE_LOGLEVEL_QUIET
	int "quiet console loglevel (1-15)"
	range 1 15
	default "4"
	help
	  loglevel to use when "quiet" is passed on the kernel commandline.

	  When "quiet" is passed on the kernel commandline this loglevel
	  will be used as the loglevel. IOW passing "quiet" will be the
	  equivalent of passing "loglevel=<CONSOLE_LOGLEVEL_QUIET>"

config PCI
	def_bool y
	select NO_GENERIC_PCI_IOPORT_MAP
	select GENERIC_PCI_IOMAP
	select HAS_DMA
	select DMA_OPS
	select PCI_MSI
	select PCI_DOMAINS
	select PCI_DOMAINS_GENERIC
	select PCI_DEBUG if DEBUG_KERNEL

config RAID6_PQ_BENCHMARK
	bool
	default n

config STACKTRACE_SUPPORT
	def_bool y

config NLS_DEFAULT
	default "utf8"
```
